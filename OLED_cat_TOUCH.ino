/* modified by A.Sardo for Piccolino - March 2015 */

#include <SPI.h>
#include <Wire.h>
#include <Piccolino_OLED.h>
#include "OLED_cat.h"
#include <Piccolino_RAM.h>
#include <CapacitiveSensor.h>

CapacitiveSensor   tleft = CapacitiveSensor(2,3);
CapacitiveSensor   tright = CapacitiveSensor(2,4);

#define TRIGGER_LEVEL 5 // change as appropriate

PROGMEM const unsigned char logo [] = {
0x00, 0x00, 0x00, 0x00, 0x00, 0x00, 0x00, 0x00, 0x00, 0x00, 0x00, 0x00, 0x00, 0x00, 0x00, 0x00,
0x00, 0x00, 0x00, 0x00, 0x00, 0x00, 0x00, 0x00, 0x00, 0x00, 0x00, 0x00, 0x00, 0x00, 0x00, 0x00,
0x00, 0x00, 0x00, 0x00, 0x00, 0x00, 0x00, 0x00, 0x00, 0x00, 0x00, 0x00, 0x00, 0x00, 0x00, 0x00,
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0x00, 0x00, 0x00, 0x00, 0x00, 0x00, 0x00, 0x00, 0x00, 0x00, 0x00, 0x00, 0x00, 0x00, 0x00, 0x00
};

Piccolino_OLED display;
Piccolino_RAM ram;

unsigned long time = 0;

void setup(){

  display.begin();
  ram.begin();

}


void drawBitmap(int16_t x, int16_t y, const unsigned char *bitmap, int16_t w, int16_t h) {
  int16_t i, j, byteWidth = (w + 7) / 8;

  display.clear();

  long t1 =  tleft.capacitiveSensor(30)/10;
  long t2 =  tright.capacitiveSensor(30)/10;
    
    if(t1>TRIGGER_LEVEL&&t2>TRIGGER_LEVEL) {
      display.setCursor(30,20);
      display.print(F("BOTH"));
      display.update();
      delay(1000);
    } else {
      if(t1>TRIGGER_LEVEL) {
        display.setCursor(0,20);
        display.print(F("LEFT"));
        display.update();
        delay(1000);
      }
      if(t2>TRIGGER_LEVEL) {
        display.setCursor(40,20);
        display.print(F("RIGHT"));
        display.update();
        delay(1000);
      }
    }

  for(j=0; j<h; j++) {
    for(i=0; i<w; i++ ) {
      if(pgm_read_byte(bitmap + j * byteWidth + i / 8) & (128 >> (i & 7))) {
        display.drawPixel(x+i, y+j, WHITE);
      }
    }
  }
  
    display.update();

}
char aa=9;

void loop(){  

  byte data_to_chip[17] = "Testing 90123456";
  byte local_buff[17] = "                ";
  int i = 0;

  drawBitmap(0,0,logo,128,64);
  delay(1000);
  

  for(i=0; i<32752; i+=16) {
    ram.write(i,data_to_chip,16);  
    memset(local_buff,0,16);
    ram.read(i,local_buff,16);
     if(memcmp((char *)data_to_chip,(char *)local_buff,16)) {
        display.clear();
        display.setTextSize(2);
        display.setCursor(11,15);
        display.print("RAM FAILED");       
        display.update();
        while(1);
     }
  }

  display.clear();
  display.setTextSize(2);
  display.setCursor(20,15);
  display.print("SRAM OK!");       
  display.update();
  delay(1000);
  display.setTextSize(3);
  
  while(1) {    
  drawBitmap(35,0,img1,64,62);
  delay(aa);
  drawBitmap(0,0,img2,128,64);
  delay(aa);
  drawBitmap(0,0,img3,128,64);
  delay(aa);
  drawBitmap(0,0,img2,128,64);
  delay(aa);
  drawBitmap(35,0,img1,64,62);
  delay(aa);
  drawBitmap(0,0,img4,128,64);
  delay(aa);
  drawBitmap(0,0,img5,128,64);
  delay(aa);
  drawBitmap(0,0,img4,128,64);
  delay(aa);
  
  }
  

}
